## sysdrv/tools/board/buildroot/packages/btop/Config.in
```kconfig
config BR2_PACKAGE_BTOP
	bool "btop"
	depends on BR2_arm
	help
	  A resource monitor for Linux. Installs the upstream ARMv7
	  musl static release binary.
```

## sysdrv/tools/board/buildroot/packages/vpn-web/Config.in
```kconfig
config BR2_PACKAGE_VPN_WEB
	bool "vpn-web native CGI"
	depends on BR2_TOOLCHAIN_HAS_SYNC_4
	select BR2_PACKAGE_JSON_C
	help
	  Native authenticated WireGuard dashboard reads, with serialized
	  Python management routes and deploy-time legacy rollback.
```
